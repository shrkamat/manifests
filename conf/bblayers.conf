## conf/bblayers.conf
```bitbake
# POKY_BBLAYERS_CONF_VERSION is increased each time build/conf/bblayers.conf
# changes incompatibly
POKY_BBLAYERS_CONF_VERSION = "2"

BBPATH = "${TOPDIR}"
BBFILES ?= ""

BBLAYERS ?= " \
  /home/skm/yocto-test/sources/poky/meta \
  /home/skm/yocto-test/sources/poky/meta-poky \
  /home/skm/yocto-test/sources/poky/meta-yocto-bsp \
  /home/skm/yocto-test/sources/meta-openembedded/meta-oe \
  /home/skm/yocto-test/sources/meta-openembedded/meta-python \
  /home/skm/yocto-test/sources/meta-openembedded/meta-networking \
  /home/skm/yocto-test/sources/meta-openembedded/meta-multimedia \
  /home/skm/yocto-test/sources/meta-raspberrypi \
  /home/skm/yocto-test/sources/meta-gstreamer1.0 \
  /home/skm/yocto-test/sources/meta-webkit \
  /home/skm/yocto-test/sources/meta-clang \
  /home/skm/yocto-test/sources/meta-flutter \
  "
```
